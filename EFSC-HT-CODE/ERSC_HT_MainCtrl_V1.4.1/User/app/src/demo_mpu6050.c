/*
*********************************************************************************************************
*
*	模块名称 : MPU-6050读写演示模块。
*	文件名称 : demo_mpu6050.c
*	版    本 : V1.0
*	说    明 : 三轴陀螺仪MPU-6050读写例程。
*
*	修改记录 :
*		版本号  日期        作者     说明
*		V1.0    2013-02-01 		    正式发布
*
*
*********************************************************************************************************
*/

#include "bsp.h"
#include "inv_mpu.h"
#include "inv_mpu_dmp_motion_driver.h" 

/* 仅允许本文件内调用的函数声明 */
static void DispMenu(void);

/*
*********************************************************************************************************
*	函 数 名: DemoMPU6050
*	功能说明: MPU6050  demo
*	形    参：无
*	返 回 值: 无
*********************************************************************************************************
*/
void DemoMPU6050(void)
{
	float pitch,roll,yaw; 	        //欧拉角	 
	uint8_t	ucRes;					//返化结果
	
	if (i2c_CheckDevice(MPU6050_SLAVE_ADDRESS) == 0)
	{
		printf("MPU-6050 Ok (0x%02X)\r\n", MPU6050_SLAVE_ADDRESS);
	}
	else
	{
		printf("MPU-6050 Err (0x%02X)\r\n", MPU6050_SLAVE_ADDRESS);
	}

	DispMenu();		/* 打印命令提示 */

	bsp_InitMPU6050();
	
	/* 初始化DMP */
	ucRes = MPU6050_DmpInit();
	while(ucRes != 0)         
	{   
		printf("\r\nDMP初始化失败，失败步骤为：%d \r\n",ucRes);
		bsp_LedOn(1);		//LED1点亮,表示初始化失败
	}

//	bsp_StartAutoTimer(0, 1000);	/* 启动1个自动定时器，周期1秒 */
	while(1)
	{
		bsp_Idle();		/* 这个函数在bsp.c文件。用户可以修改这个函数实现CPU休眠和喂狗 */
		
			/* 获取原始数据 */
//			MPU6050_ReadData();		/* 读取 MPU-6050的数据到全局变量 g_tMPU6050 */

//			/* 显示 g_tMPU6050 结构体成员中的数据 */
//			{
//				printf("AX=%6d,AY=%6d,AZ=%6d,",
//					g_tMPU6050.Accel_X,
//					g_tMPU6050.Accel_Y,
//					g_tMPU6050.Accel_Z);

//				printf("GX=%6d,GY=%6d,GZ=%6d,T=%6d\r",					
//					g_tMPU6050.GYRO_X,
//					g_tMPU6050.GYRO_Y,
//					g_tMPU6050.GYRO_Z,
//					g_tMPU6050.Temp);			
//			}
			
			/* 获取DMP转换数据，并上传至上位机 */
			if(MPU6050_DmpGetData(&pitch,&roll,&yaw)==0)
			{
//				if (bsp_CheckTimer(0))		/* 检查定时周期到否 */
//				{
					fasong(roll*182,pitch*182,yaw*182);
//				}
			}
	}
}

/*
*********************************************************************************************************
*	函 数 名: DispMenu
*	功能说明: 显示操作提示菜单
*	形    参：无
*	返 回 值: 无
*********************************************************************************************************
*/
static void DispMenu(void)
{
	printf("\r\n------------------------------------------------\r\n");
	printf("请旋转主板观察陀螺仪和加速度数据:\r\n");
}

/***************************** yy-AA55 (END OF FILE) *********************************/
